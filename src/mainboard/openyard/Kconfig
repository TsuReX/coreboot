## src/mainboard/openyard/Kconfig
```kconfig
## SPDX-License-Identifier: GPL-2.0-only

if VENDOR_OPENYARD

choice
	prompt "Mainboard model"

source "src/mainboard/openyard/*/Kconfig.name"

endchoice

source "src/mainboard/openyard/*/Kconfig"

config MAINBOARD_VENDOR
	default "OpenYard"

endif # VENDOR_OPENYARD
```

## src/mainboard/openyard/moscowcity/Kconfig.name
```kconfig
## SPDX-License-Identifier: GPL-2.0-only

config BOARD_OPENYARD_MOSCOWCITY
	bool "OpenYard Gen4"
```
